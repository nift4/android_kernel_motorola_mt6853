## drivers/input/misc/fpc_fps_mmi/Kconfig
```kconfig
config INPUT_FPC_FPS_MMI
    tristate "FingerPrint Cards FP sensor motorola driver"
```

## drivers/input/touchscreen/focaltech_mtk_mmi/Kconfig
```kconfig
config FOCALTECH_MTK_MMI
    tristate "FocalTech MediaTek Motorola touch screen"
```
